## 05_wifi/main/Kconfig.projbuild.template
```kconfig
menu "User Wifi configuration"
    config LED_GPIO
        prompt "LED indicator"
        int "LED GPIO number"
        range 0 16
        default 2
        help
            Turn on the LED when Wi-Fi is connected.

    config LWIP_LOCAL_HOSTNAME
        string "Hostname"
        default "HDD_Station"
        help
            Hostname for the example to use.

    menu "Credentials"
        config SSID
            string "WiFi SSID"
            default "SSID"
            help
                SSID (network name) for the example to connect to.

        config PASSWORD
            string "WiFi Password"
            default "PASSWORD"
            help
                WiFi password (WPA or WPA2) for the example to use.
    endmenu

    choice CUSTOM_MAC
        prompt "Custom MAC address"
        default CUSTOM_MAC
        help
            MAC address for the example to use.
        config CUSTOM_MAC
            bool "Custom MAC address"
        config CUSTOM_MAC_NONE
            bool "Default MAC address"
    endchoice

    choice WIFI_SCAN
        prompt "WiFi Power save mode"
        default WIFI_PS_NONE
        help
            No power save.

            Minimum modem power saving. In this mode, station wakes up to receive beacon every DTIM period.

            Maximum modem power saving. In this mode, interval to receive beacons is determined by the listen_interval parameter in wifi_sta_config_t. Attention: Using this option may cause ping failures. Not recommended.
        config WIFI_PS_NONE
            bool "None"
        config WIFI_PS_MIN_MODEM
            bool "Minimum modem power saving"
        config WIFI_PS_MAX_MODEM
            bool "Maximum modem power saving (not recomended)"
    endchoice
endmenu
```

## 06_wifi_mqtt/main/Kconfig.projbuild.template
```kconfig
menu "User configuration"
    menu "MQTT"
        config BROKER_URL
        string "Broker URL"
        default "mqtt://192.168.89.167"
        help
            Mqtt broker URL

        config BROKER_PORT
        prompt "Broker port"
        int "Broker port"
        range 0 65535
        default 1883
        help
            Mqtt broker port

        config CLIENT_ID
        string "Clien ID"
        default "HDD_Station"
        help
            Client name

        config MQTT_USER
        string "Mqtt user"
        default "mqtt"
        help
            Mqtt broker login
        config MQTT_PASSWORD
        string "Mqtt password"
        default "PASSWORD"
        help
            Mqtt broker password

        config MQTT_KEEP_ALIVE
        int "Keep alive interval"
        default 60
        help
            Keep alive interval
    endmenu

    config LED_GPIO
        prompt "LED indicator"
        int "LED GPIO number"
        range 0 16
        default 2
        help
            Turn on the LED when Wi-Fi is connected.

    config LWIP_LOCAL_HOSTNAME
        string "Hostname"
        default "HDD_Station"
        help
            Hostname for the example to use.

    menu "WI-FI Credentials"
        config SSID
            string "WiFi SSID"
            default "SSID"
            help
                SSID (network name) for the example to connect to.

        config PASSWORD
            string "WiFi Password"
            default "PASSWORD"
            help
                WiFi password (WPA or WPA2) for the example to use.
    endmenu

    choice CUSTOM_MAC
        prompt "Custom MAC address"
        default CUSTOM_MAC
        help
            MAC address for the example to use.
        config CUSTOM_MAC
            bool "Custom MAC address"
        config CUSTOM_MAC_NONE
            bool "Default MAC address"
    endchoice

    choice WIFI_SCAN
        prompt "WiFi Power save mode"
        default WIFI_PS_NONE
        help
            No power save.

            Minimum modem power saving. In this mode, station wakes up to receive beacon every DTIM period.

            Maximum modem power saving. In this mode, interval to receive beacons is determined by the listen_interval parameter in wifi_sta_config_t. Attention: Using this option may cause ping failures. Not recommended.
        config WIFI_PS_NONE
            bool "None"
        config WIFI_PS_MIN_MODEM
            bool "Minimum modem power saving"
        config WIFI_PS_MAX_MODEM
            bool "Maximum modem power saving (not recomended)"
    endchoice
endmenu
```
